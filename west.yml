## west.yml
```yaml
manifest:
  version: "0.12"

  defaults:
    remote: zephyrproject-rtos

  remotes:
    - name: zephyrproject-rtos
      url-base: https://github.com/zephyrproject-rtos
    - name: hefajstos
      url-base: https://github.com/KoNaR-Hefajstos

  projects:
    - name: zephyr
      remote: zephyrproject-rtos
      path: zephyrproject/zephyr
      revision: main
      import: 
        path-prefix: zephyrproject

    - name: mms_chainbus_driver
      remote: hefajstos
      path: modules/mms_chainbus_driver
      
    - name: mms_hat_driver
      remote: hefajstos
      path: modules/mms_hat_driver

    - name: mms_board_definitions
      remote: hefajstos
      path: modules/mms_board_definitions
  self:
    path: .
```
